# K1921VG1T register map
Vendor: NIIET; Series: K1921VGx; File version: 2.8
MCU for automotive purposes
CPU: other r0p1, little endian, MPU, FPU, 4 interrupt priority bits
Registers are 32-bit, read-write, reset 0x0 unless marked. A register's access mark holds for its fields unless they carry their own. Offsets are from the block's base; lines under a group give offsets from that group; [hi:lo] are bit positions; {n}, {i} and the like mark numbered series; 'fields as' and 'values as' point back to an identical list; <NAME> marks a mode.

## Memory map
0x40000000 GPIOA size 0xC00 — GPIO control registers
0x40001000 GPIOB size 0xC00
0x40002000 GPIOC size 0xC00
0x40003000 GPIOD size 0xC00
0x40004000 GPIOE size 0xC00
0x40005000 GPIOF size 0xC00
0x40006000 GPIOG size 0xC00
0x41000000 CANFD0 size 0x100 — CANFD control registers
0x41001000 CANFD1 size 0x100
0x41002000 CANFD2 size 0x100
0x41003000 CANFD3 size 0x100
0x41010000 CAN size 0x600 — CAN control registers
0x41011000 CANMSG size 0x2000 — CAN message registers
0x41020000 ADC size 0x780 — ADC control registers
0x41030000 QSPI0 size 0x38 — QSPI control registers
0x41040000 QSPI1 size 0x38
0x41050000 CRC size 0x14 — Cyclic redundancy check module
0x41060000 HASH size 0x60 — HASH registers
0x41070000 CRYPTO size 0x8C — Cryptographic calculation support module
0x41080000 USBDC0 size 0x208 — USBDC control registers
0x41080800 USBCTR0 size 0x10 — USB common registers
0x41081000 USBHC0 size 0x814 — USBHC control registers
0x41090000 USBDC1 size 0x208
0x41090800 USBCTR1 size 0x10
0x41091000 USBHC1 size 0x814
0x50000000 DMA size 0x1040 — DMA control registers
0x50002000 FLASHM size 0x1A0 — Flash control registers
0x50003000 SIU size 0x148 — System interconnect unit
0x50004000 RCU size 0x134 — Reset and clock unit
0x50005000 RTC size 0x60 — RTC control registers
0x50006000 WDT size 0xC04 — Watchdog timer
0x50007000 SRAM size 0x2C — SRAM ECC control unit
0x50008000 TRNG size 0x100 — True random number generator
0x50009000 EMC size 0x20 — External memory control module
0x5000A000 SDRAM size 0x1C — SDRAM controller unit
0x5000B000 ETH size 0x80 — Ethernet control registers
0x5000C000 FLASHD size 0x1A0 — Flash control registers
0x5000D000 PWM0 size 0x9C — PWM control registers
{0x5000D000+0x1000*n} PWM{n} size 0x9C (n=1..15)
0x51000000 ACMP0 size 0x20 — Analog comparator control registers
0x51001000 ACMP1 size 0x20
0x51002000 ACMP2 size 0x20
0x51003000 ACMP3 size 0x20
0x51004000 DAC0 size 0x40 — DAC control registers
0x51005000 DAC1 size 0x40
0x51006000 I2S0 size 0x34 — I2S control registers
0x51007000 I2S1 size 0x34
0x51008000 TMR0 size 0x140 — Timer control registers
{0x51008000+0x1000*n} TMR{n} size 0x140 (n=1..15)
0x52000000 LIN0 size 0x64 — LIN control registers
0x52001000 LIN1 size 0x64
0x52002000 LIN2 size 0x64
0x52003000 LIN3 size 0x64
0x52004000 LIN4 size 0x64
0x52005000 LIN5 size 0x64
0x52006000 LIN6 size 0x64
0x52007000 LIN7 size 0x64
0x52008000 SPI0 size 0x28 — SPI control registers
0x52009000 SPI1 size 0x28
0x5200A000 SPI2 size 0x28
0x5200B000 SPI3 size 0x28
0x5200C000 SPI4 size 0x28
0x5200D000 SPI5 size 0x28
0x5200E000 SPI6 size 0x28
0x5200F000 SPI7 size 0x28
0x52010000 UART0 size 0x4C — UART control registers
0x52011000 UART1 size 0x4C
0x52012000 UART2 size 0x4C
0x52013000 UART3 size 0x4C
0x52014000 UART4 size 0x4C
0x52015000 UART5 size 0x4C
0x52016000 UART6 size 0x4C
0x52017000 UART7 size 0x4C
0x52018000 I2C0 size 0x48 — I2C control registers
0x52019000 I2C1 size 0x48
0x5201A000 I2C2 size 0x48
0x5201B000 I2C3 size 0x48
0x5201C000 MSC size 0x50 — MSC control registers

## Interrupts
1 WDT — Watchdog timer interrupt
2 RCU — Reset and clock unit interrupt
3 RTC — RTC combine interrupt
4 FLASH (FLASHM) — FLASH (main array and data array) combine interrupt
5 SRAM — SRAM interrupt
7 SIU — System Interconnect Unit interrupt
8 GPIOA — GPIO A interrupt
9 GPIOB — GPIO B interrupt
10 GPIOC — GPIO C interrupt
11 GPIOD — GPIO D interrupt
12 GPIOE — GPIO E interrupt
13 GPIOF — GPIO F interrupt
14 GPIOG — GPIO G interrupt
15 ETH — Ethernet interrupt
{n+16} TMR{n} (n=0..15) — Timer {n} combine interrupt
{n+32} DMA_CH{n} (DMA) (n=0..31) — DMA channel {n} interrupt
{3n+64} UART{n} (n=0..7) — UART{n} combine interrupt
{3n+65} UART{n}_TD (UART{n}) (n=0..7) — UART{n} transmit done interrupt
{3n+66} UART{n}_RX (UART{n}) (n=0..7) — UART{n} recieve interrupt
{n+88} TMR0_CC{n} (TMR0) (n=0..7) — Timer 0 CAPCOM {n} interrupt
{n+96} TMR1_CC{n} (TMR1) (n=0..7) — Timer 1 CAPCOM {n} interrupt
{n+104} TMR2_CC{n} (TMR2) (n=0..7) — Timer 2 CAPCOM {n} interrupt
{n+112} TMR3_CC{n} (TMR3) (n=0..7) — Timer 3 CAPCOM {n} interrupt
{3n+120} SPI{n} (n=0..7) — SPI{n} combine interrupt
{3n+121} SPI{n}_RX (SPI{n}) (n=0..7) — SPI{n} receive interrupt
{3n+122} SPI{n}_TX (SPI{n}) (n=0..7) — SPI{n} transmit interrupt
{n+144} LIN{n} (n=0..7) — LIN{n} combine interrupt
152 TMR0_PERIOD (TMR0) — Timer 0 period interrupt
153 TMR1_PERIOD (TMR1) — Timer 1 period interrupt
154 TMR2_PERIOD (TMR2) — Timer 2 period interrupt
155 TMR3_PERIOD (TMR3) — Timer 3 period interrupt
156 I2C0 — I2C0 interrupt
157 I2C1 — I2C1 interrupt
158 I2C2 — I2C2 interrupt
159 I2C3 — I2C3 interrupt
160 I2S0_TX (I2S0) — I2S0 transmit interrupt
161 I2S0_RX (I2S0) — I2S0 receive interrupt
162 I2S1_TX (I2S1) — I2S1 transmit interrupt
163 I2S1_RX (I2S1) — I2S1 receive interrupt
164 USB0 (USBCTR0) — USB0 interrupt
165 USB1 (USBCTR1) — USB1 interrupt
166 QSPI0 — QSPI0 interrupt
167 QSPI1 — QSPI1 interrupt
170 CANFD0 — CANFD0 interrupt
171 CANFD0_TIMER (CANFD0) — CANFD0 Timer interrupt
172 CANFD0_ECC (CANFD0) — CANFD0 ECC Single/Double Error detection interrupt
173 CANFD1 — CANFD1 interrupt
174 CANFD1_TIMER (CANFD1) — CANFD1 Timer interrupt
175 CANFD1_ECC (CANFD1) — CANFD1 ECC Single/Double Error detection interrupt
176 CANFD2 — CANFD2 interrupt
177 CANFD2_TIMER (CANFD2) — CANFD2 Timer interrupt
178 CANFD2_ECC (CANFD2) — CANFD2 ECC Single/Double Error detection interrupt
179 CANFD3 — CANFD3 interrupt
180 CANFD3_TIMER (CANFD3) — CANFD3 Timer interrupt
181 CANFD3_ECC (CANFD3) — CANFD3 ECC Single/Double Error detection interrupt
{n+182} CAN_{n} (CAN) (n=0..15) — CAN_{n} interrupt
{n+198} ADC_SEQ{n} (ADC) (n=0..7) — ADC sequencer {n} interrupt
206 ADC_DC (ADC) — ADC digital comparator interrupt
207 ACMP0 — ACMP0 interrupt
208 ACMP1 — ACMP1 interrupt
209 ACMP2 — ACMP2 interrupt
210 ACMP3 — ACMP3 interrupt
211 TRNG — TRNG interrupt
212 HASH — HASH interrupt
213 CRYPTO — CRYPTO interrupt
214 RTC_ALARM1 (RTC) — RTC alarm 1 interrupt
215 RTC_ALARM2 (RTC) — RTC alarm 2 interrupt
216 RTC_BATTERY (RTC) — RTC switch to battery power supply interrupt
217 RTC_N_POWER (RTC) — RTC switch to normal power supply interrupt
218 RTC_OVERFLOW (RTC) — RTC counter overflow interrupt
219 PWMx_TZ (PWM0) — PWM TZ combine interrupt
{2n+220} PWM{n} (n=0..15) — PWM{n} interrupt
{2n+221} PWM{n}_HD (PWM{n}) (n=0..15) — PWM{n} HD interrupt
252 MSC — MSC combined interrupt
253 MSC_upstream (MSC) — MSC upstream combined interrupt
254 MSC_downstream (MSC) — MSC downstream combined interrupt

## Licence text in the file
THIS SOFTWARE IS PROVIDED "AS IS". NO WARRANTIES, WHETHER EXPRESS, IMPLIED OR STATUTORY, INCLUDING, BUT NOT LIMITED TO, IMPLIED WARRANTIES OF MERCHANTABILITY AND FITNESS FOR A PARTICULAR PURPOSE APPLY TO THIS SOFTWARE. ARM SHALL NOT, IN ANY CIRCUMSTANCES, BE LIABLE FOR SPECIAL, INCIDENTAL, OR CONSEQUENTIAL DAMAGES, FOR ANY REASON WHATSOEVER.
